#include "oled.h"
#include "i2c.h"
#include <string.h>
#include <stdio.h>

extern I2C_HandleTypeDef hi2c1;

#define OLED_CMD    0x00
#define OLED_DATA   0x40

static uint8_t oled_buf[128 * 64 / 8];
static uint8_t oled_ok = 1;   /* 0=未检测到OLED, 跳过所有I2C操作 */

static const uint8_t Font6x8[][6] = {
    {0x00,0x00,0x00,0x00,0x00,0x00}, /* space */
    {0x00,0x00,0x5F,0x00,0x00,0x00}, /* ! */
    {0x00,0x07,0x00,0x07,0x00,0x00}, /* " */
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    {0x44,0x64,0x54,0x4C,0x44,0x00}, /* z */
};

static void oled_write_cmd(uint8_t cmd)
{
    HAL_I2C_Mem_Write(&hi2c1, OLED_ADDR << 1, OLED_CMD, 1, &cmd, 1, 10);
}

static void oled_write_data(uint8_t *data, uint16_t len)
{
    HAL_I2C_Mem_Write(&hi2c1, OLED_ADDR << 1, OLED_DATA, 1, data, len, 100);
}

void OLED_Init(void)
{
    static const uint8_t init_cmds[] = {
        0xAE,        /* Display OFF */
        0xD5, 0x80,  /* Set clock divide ratio */
        0xA8, 0x3F,  /* Set multiplex ratio (64) */
        0xD3, 0x00,  /* Display offset */
        0x40,        /* Start line */
        0x8D, 0x14,  /* Charge pump */
        0x20, 0x00,  /* Memory mode: horizontal */
        0xA1,        /* Segment remap */
        0xC8,        /* COM scan direction */
        0xDA, 0x12,  /* COM pins */
        0x81, 0xCF,  /* Contrast */
        0xD9, 0xF1,  /* Pre-charge period */
        0xDB, 0x40,  /* VCOMH deselect */
        0xA4,        /* Display all on resume */
        0xA6,        /* Normal display */
        0xAF         /* Display ON */
    };

    /* 检测I2C设备是否存在, 不存在则跳过后续操作避免阻塞 */
    if (HAL_I2C_IsDeviceReady(&hi2c1, OLED_ADDR << 1, 3, 50) != HAL_OK) {
        oled_ok = 0;
        return;
    }

    /* Send each command individually */
    for (uint8_t i = 0; i < sizeof(init_cmds); i++) {
        oled_write_cmd(init_cmds[i]);
    }

    OLED_Clear();
    OLED_Refresh();
}

void OLED_Clear(void)
{
    memset(oled_buf, 0, sizeof(oled_buf));
}

void OLED_SetCursor(uint8_t x, uint8_t y)
{
    oled_write_cmd(0xB0 + (y & 0x07));
    oled_write_cmd(0x00 + (x & 0x0F));
    oled_write_cmd(0x10 + ((x >> 4) & 0x0F));
}

void OLED_Refresh(void)
{
    if (!oled_ok) return;
    for (uint8_t page = 0; page < 8; page++) {
        oled_write_cmd(0xB0 + page);
        oled_write_cmd(0x00);
        oled_write_cmd(0x10);
        oled_write_data(&oled_buf[page * 128], 128);
    }
}

void OLED_ShowString(uint8_t x, uint8_t y, const char *str, uint8_t size)
{
    while (*str) {
        if (x + 6 > OLED_WIDTH) { x = 0; y++; }
        if (y > 7) break;

        char c = *str++;
        if (c < ' ' || c > 'z') c = ' ';
        const uint8_t *glyph = Font6x8[c - ' '];

        for (uint8_t i = 0; i < 6; i++) {
            uint16_t idx = (uint16_t)y * 128 + x + i;
            if (idx < (uint16_t)sizeof(oled_buf)) {
                if (size == 1) {
                    oled_buf[idx] = glyph[i];
                } else {
                    uint8_t col = glyph[i];
                    uint8_t expanded = 0;
                    if (col & 0x01) expanded |= 0x03;
                    if (col & 0x02) expanded |= 0x0C;
                    if (col & 0x04) expanded |= 0x30;
                    if (col & 0x08) expanded |= 0xC0;
                    /* Write expanded column to two rows */
                    if (y < 7) oled_buf[idx] = expanded;
                    if (y < 7) oled_buf[idx + 128] = expanded;
                }
            }
        }
        x += 6;
    }
}

void OLED_DrawTitle(const char *title)
{
    uint8_t len = strlen(title);
    uint8_t x = (len * 6 < OLED_WIDTH) ? (OLED_WIDTH - len * 6) / 2 : 0;
    OLED_Clear();
    OLED_ShowString(x, 0, (char *)title, 1);
    OLED_Refresh();
}

void OLED_Update(float x_mm, float y_mm, const char *status, float speed)
{
    if (!oled_ok) return;
    char buf[32];
    OLED_Clear();

    /* 转为居中坐标系 (-350~+350), 与PC上位机一致 */
    float cx = x_mm - 350.0f;
    float cy = y_mm - 350.0f;

    OLED_ShowString(0, 0, "XYTable Controller", 1);
    OLED_ShowString(0, 2, "X:", 1);
    snprintf(buf, sizeof(buf), "%+7.1f mm", cx);
    OLED_ShowString(18, 2, buf, 1);

    OLED_ShowString(0, 3, "Y:", 1);
    snprintf(buf, sizeof(buf), "%+7.1f mm", cy);
    OLED_ShowString(18, 3, buf, 1);

    OLED_ShowString(0, 5, "St:", 1);
    OLED_ShowString(18, 5, (char *)status, 1);

    OLED_ShowString(0, 6, "Sp:", 1);
    snprintf(buf, sizeof(buf), "%.0f mm/min", speed);
    OLED_ShowString(18, 6, buf, 1);

    OLED_Refresh();
}
